## Firmware/sdkconfig.defaults
```kconfig
# Flash 16MB
CONFIG_ESPTOOLPY_FLASHSIZE_16MB=y
CONFIG_ESPTOOLPY_FLASHSIZE="16MB"

# Custom partition
CONFIG_PARTITION_TABLE_CUSTOM=y
CONFIG_PARTITION_TABLE_CUSTOM_FILENAME="partitions.csv"
CONFIG_PARTITION_TABLE_FILENAME="partitions.csv"
CONFIG_PARTITION_TABLE_OFFSET=0x8000

# Enable rollback (firmware verification after reboot)
CONFIG_BOOTLOADER_APP_ROLLBACK_ENABLE=y

# PSRAM 8MB
CONFIG_SPIRAM=y
CONFIG_SPIRAM_MODE_OCT=y
CONFIG_SPIRAM_SPEED_80M=y

# CPU Freq 240MHz
CONFIG_ESP_DEFAULT_CPU_FREQ_MHZ_240=y
CONFIG_ESP_DEFAULT_CPU_FREQ_MHZ=240

# Websocket support
CONFIG_HTTPD_WS_SUPPORT=y

# Bluetooth support
CONFIG_BT_ENABLED=y
CONFIG_BT_NIMBLE_ENABLED=y
CONFIG_BT_NIMBLE_50_FEATURE_SUPPORT=n

# fix for long headers on android requests to captive portal
CONFIG_HTTPD_MAX_REQ_HDR_LEN=1024

# Increase FreeRTOS scheduler update rate
CONFIG_FREERTOS_HZ=1000

# Force default tasks on CORE_BRAIN (Let CORE_REFLEX alone)
CONFIG_ESP_MAIN_TASK_AFFINITY_CPU0=y
CONFIG_ESP_WIFI_TASK_PINNED_TO_CORE_0=y
CONFIG_ESP_SYSTEM_EVENT_TASK_PINNED_TO_CORE_0=y
CONFIG_LWIP_TCPIP_TASK_AFFINITY_CPU0=y
CONFIG_BT_NIMBLE_PINNED_TO_CORE_0=y
# Following flags may be useful but needs testing
# (we don't want to eat all the ram because of them)
# CONFIG_SPIRAM_ALLOW_STACK_EXTERNAL_MEMORY=n
# CONFIG_SPIRAM_MALLOC_ALWAYSINTERNAL=4096

# Increase the max number of open sockets
CONFIG_LWIP_MAX_SOCKETS=24

# Enable task stats for CPU usage
CONFIG_FREERTOS_GENERATE_RUN_TIME_STATS=y
CONFIG_FREERTOS_USE_STATS_FORMATTING_FUNCTIONS=y

# Enable OV2640 support in esp32-camera module
CONFIG_OV2640_SUPPORT=y
```
